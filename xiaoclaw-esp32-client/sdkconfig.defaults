## xiaoclaw-esp32-client/sdkconfig.defaults
```kconfig
# ESP-IDF v5.3 настройки по умолчанию для XiaoClaw ESP32-P4 Client

# Целевая платформа
CONFIG_IDF_TARGET="esp32p4"

# WiFi настройки
CONFIG_ESP_WIFI_SOFTAP_SUPPORT=y
CONFIG_ESP_WIFI_STA_DISCONNECTED_PM_ENABLE=y

# LVGL настройки
CONFIG_LV_COLOR_DEPTH_16=y
CONFIG_LV_COLOR_16_SWAP=y
CONFIG_LV_USE_FLEX=y
CONFIG_LV_USE_GRID=y
CONFIG_LV_FONT_MONTSERRAT_14=y
CONFIG_LV_FONT_MONTSERRAT_16=y
CONFIG_LV_FONT_MONTSERRAT_24=y
CONFIG_LV_FONT_MONTSERRAT_48=y
CONFIG_LV_DPI_DEF=130

# Настройки дисплея
CONFIG_LCD_PANEL_IO_FORMAT_BUF_SIZE=32
CONFIG_LCD_RGB_PANEL_NUM_FRAME_BUFFERS=2

# Настройки тачскрина
CONFIG_LCD_TOUCH_GT911=y

# Аудио настройки
CONFIG_ESP_CODEC_DEV=y
CONFIG_ESP_CODEC_DEV_OUTPUT_DEVICE=y
CONFIG_ESP_CODEC_DEV_INPUT_DEVICE=y

# HTTP клиент
CONFIG_ESP_HTTP_CLIENT_ENABLE_HTTPS=y

# Логирование
CONFIG_LOG_DEFAULT_LEVEL_INFO=y
CONFIG_LOG_DEFAULT_LEVEL=3

# FreeRTOS настройки
CONFIG_FREERTOS_HZ=1000

# Компонент esp_lcd
CONFIG_ESP_LCD_ENABLE_JD9365=y
CONFIG_ESP_LCD_ENABLE_GT911=y

# MIPI DSI настройки
CONFIG_ESP_LCD_MIPI_DSI=y

# Отладка
CONFIG_COMPILER_OPTIMIZATION_DEBUG=y
```
